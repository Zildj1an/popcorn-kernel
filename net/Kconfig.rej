## net/Kconfig.rej
```kconfig
--- net/Kconfig
+++ net/Kconfig
@@ -442,7 +442,6 @@ config MAY_USE_DEVLINK
 
 config PAGE_POOL
        bool
-       default y
 
 config FAILOVER
 	tristate "Generic failover module"
```

## net/sched/Kconfig.rej
```kconfig
--- net/sched/Kconfig
+++ net/sched/Kconfig
@@ -912,6 +912,17 @@ config NET_ACT_TUNNEL_KEY
 	  To compile this code as a module, choose M here: the
 	  module will be called act_tunnel_key.
 
+config NET_ACT_CT
+        tristate "Connection tracking action"
+        depends on NET_CLS_ACT
+        ---help---
+          Say Y here to enable connection tracking action.
+
+          If unsure, say N.
+
+          To compile this code as a module, choose M here: the
+          module will be called act_conntrack.
+
 config NET_IFE_SKBMARK
         tristate "Support to encoding decoding skb mark on IFE action"
         depends on NET_ACT_IFE
```
